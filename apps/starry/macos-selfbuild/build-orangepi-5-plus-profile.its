## apps/starry/macos-selfbuild/build-orangepi-5-plus-profile.its
```
/dts-v1/;

/ {
	description = "TGOSKits StarryOS OrangePi 5 Plus kernel profile";
	#address-cells = <1>;

	images {
		kernel {
			description = "StarryOS kernel";
			data = /incbin/("${kernel_bin}");
			type = "kernel";
			arch = "arm64";
			os = "linux";
			compression = "none";
			load = <0x00400000>;
			entry = <0x00400000>;

			hash-1 {
				algo = "sha256";
			};
		};

		fdt {
			description = "OrangePi 5 Plus device tree";
			data = /incbin/("/home/wuxun/Projects/tgoskits-orangepi-profile/os/StarryOS/configs/board/orangepi-5-plus.dtb");
			type = "flat_dt";
			arch = "arm64";
			compression = "none";
			load = <0x0a100000>;

			hash-1 {
				algo = "sha256";
			};
		};
	};

	configurations {
		default = "config-starry-profile";

		config-starry-profile {
			description = "StarryOS profiling on OrangePi 5 Plus";
			kernel = "kernel";
			fdt = "fdt";
		};
	};
};
```
